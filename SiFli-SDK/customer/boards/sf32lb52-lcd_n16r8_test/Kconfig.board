## SiFli-SDK/customer/boards/sf32lb52-lcd_n16r8_test/lcpu/Kconfig.board
```kconfig
config BSP_USING_BOARD_SF32LB52_LCD_N16R8_TEST
    bool
    select SOC_SF32LB52X
    select BF0_LCPU
    default y

rsource "../Kconfig.board"
```

## ex1/rtt/project/build_sf32lb52-lcd_n16r8_test_hcpu/Kconfig
```kconfig
source "$SIFLI_SDK/Kconfig.v2"
source "$SIFLI_SDK/customer/boards/Kconfig.v2"
source "d:/dev/sf32/efuse1/SiFli-SDK/customer/boards/sf32lb52-lcd_n16r8_test/hcpu/Kconfig.board"
osource "D:/dev/sf32/efuse1/ex1/rtt/project/sf-pkgs/Kconfig.conandeps"
source "D:/dev/sf32/efuse1/ex1/rtt/project/Kconfig.proj"
```

## ex1/rtt/project/build_sf32lb52-lcd_n16r8_test_hcpu/bootloader/Kconfig
```kconfig
source "$SIFLI_SDK/Kconfig.v2"
source "$SIFLI_SDK/customer/boards/Kconfig.v2"
source "d:/dev/sf32/efuse1/SiFli-SDK/customer/boards/sf32lb52-lcd_n16r8_test/hcpu/Kconfig.board"
osource "d:/dev/sf32/efuse1/SiFli-SDK/example/boot_loader/project/butterflmicro/ram_v2/sf-pkgs/Kconfig.conandeps"
source "d:/dev/sf32/efuse1/SiFli-SDK/example/boot_loader/project/butterflmicro/ram_v2/Kconfig.proj"
```

## ex1/rtt/project/build_sf32lb52-lcd_n16r8_test_hcpu/ftab/Kconfig
```kconfig
source "$SIFLI_SDK/Kconfig.v2"
source "$SIFLI_SDK/customer/boards/Kconfig.v2"
source "e:/study/sf32/SiFli-SDK/customer/boards/sf32lb52-lcd_n16r8_test/hcpu/Kconfig.board"
source "e:/study/sf32/SiFli-SDK/example/flash_table/sf32lb52x_common_v2/Kconfig.proj"
```

## ex1/rtt/project/build_sf32lb52-lcd_n16r8_test_hcpu/lcpu/Kconfig
```kconfig
source "$SIFLI_SDK/Kconfig.v2"
source "$SIFLI_SDK/customer/boards/Kconfig.v2"
source "E:/study/sf32/SiFli-SDK/customer/boards/sf32lb52-lcd_n16r8_test/lcpu/Kconfig.board"
source "E:/study/sf32/SiFli-SDK/example/ble/lcpu_general/project/common/Kconfig.proj"
```

## ex1/rtt/project/build_sf32lb52-nano_n16r16_hcpu/Kconfig
```kconfig
source "$SIFLI_SDK/Kconfig.v2"
source "$SIFLI_SDK/customer/boards/Kconfig.v2"
source "E:/study/sf32/SiFli-SDK/customer/boards/sf32lb52-nano_n16r16/hcpu/Kconfig.board"
source "E:/study/sf32/SiFli-SDK/example/get-started/hello_world/rtt/project/Kconfig.proj"
```

## ex1/rtt/project/build_sf32lb52-nano_n16r16_hcpu/ftab/Kconfig
```kconfig
source "$SIFLI_SDK/Kconfig.v2"
source "$SIFLI_SDK/customer/boards/Kconfig.v2"
source "E:/study/sf32/SiFli-SDK/customer/boards/sf32lb52-nano_n16r16/hcpu/Kconfig.board"
source "E:/study/sf32/SiFli-SDK/example/flash_table/sf32lb52x_common_v2/Kconfig.proj"
```
